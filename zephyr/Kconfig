## zephyr/vcc_power_manager/Kconfig
```kconfig
config ZMK_VCC_POWER_MANAGER
    bool "VCC Power Manager for nice!nano v2"
    default y
    depends on BOARD_NICE_NANO_V2
    depends on GPIO
    help
        Initialize P0.13 GPIO to control 3.3V VCC power on nice!nano v2.
        This allows manual control via ext-power toggle to turn off
        VCC power and significantly reduce battery consumption from
        components like OLED displays, RGB LEDs, etc.
```
